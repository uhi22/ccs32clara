VERSION ""

NS_ :

BS_:
BU_:
BO_ 1383 FOCCCI01: 8 Vector__XXX
   SG_ foccci_uptime_s : 7|24@0+ (1,0) [0|1e+06] "s" Vector__XXX

BA_DEF_ BO_ "GenMsgBackgroundColor" STRING ;
BA_DEF_ BO_ "GenMsgForegroundColor" STRING ;
BA_DEF_ BO_ "filterlabeling" INT 0 0;
BA_DEF_DEF_ "GenMsgBackgroundColor" "#ffffff";
BA_DEF_DEF_ "GenMsgForegroundColor" "#000000";
BA_DEF_DEF_ "filterlabeling" 1;
